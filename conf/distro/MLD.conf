## conf/distro/MLD.conf
```bitbake
DISTRO = "MLD"
DISTRO_NAME = "MLD"
DISTRO_VERSION = "6.0"

hostname_pn-base-files = "mld"

MAINTAINER = "Claus Muus <mld@clausmuus.de>"

TARGET_VENDOR = "-mld"

LOCALCONF_VERSION = "1"


MLD_DEFAULT_DISTRO_FEATURES = "largefile opengl ptest multiarch wayland"
MLD_DEFAULT_EXTRA_RDEPENDS = "packagegroup-core-boot"
MLD_DEFAULT_EXTRA_RRECOMMENDS = "kernel-module-af-packet"

DISTRO_FEATURES ?= "${DISTRO_FEATURES_DEFAULT} ${DISTRO_FEATURES_LIBC} ${MLD_DEFAULT_DISTRO_FEATURES}"

PREFERRED_PROVIDER_udev = "udev"
PREFERRED_PROVIDER_jpeg = "jpeg"
PREFERRED_PROVIDER_jpeg-native = "jpeg-native"

DISTRO_EXTRA_RDEPENDS += " ${MLD_DEFAULT_EXTRA_RDEPENDS}"
DISTRO_EXTRA_RRECOMMENDS += " ${MLD_DEFAULT_EXTRA_RRECOMMENDS}"

INHERIT += "blacklist"
require conf/distro/recipe-blacklist-mld.inc


#QEMU_TARGETS ?= "arm i386 mips mipsel ppc x86_64"

SANITY_TESTED_DISTROS ?= " \
            Debian GNU/Linux 8 (jessie) \n \
            Debian-8.2 \n \
            Debian-9 \n \
            Ubuntu-14.04 \n \
	    "


# Default hash policy for distro
BB_SIGNATURE_HANDLER ?= 'OEBasicHash'
#
# OELAYOUT_ABI allows us to notify users when the format of TMPDIR changes in 
# an incompatible way. Such changes should usually be detailed in the commit
# that breaks the format and have been previously discussed on the mailing list 
# with general agreement from the core team.
#
OELAYOUT_ABI = "8"

#INITRAMFS_FSTYPES = "cpio.gz"
#INITRAMFS_IMAGE = "mld-image-initramfs"
#INITRAMFS_IMAGE_BUNDLE = "1"

#IMAGE_FSTYPES = "iso"
```

## conf/layer.conf
```bitbake
# We have a conf and classes directory, append to BBPATH
BBPATH .= ":${LAYERDIR}"

# We have a recipes directory, add to BBFILES
BBFILES += "${LAYERDIR}/recipes-*/*.bb ${LAYERDIR}/recipes-*/*.bbappend \
            ${LAYERDIR}/recipes-*/*/*.bb ${LAYERDIR}/recipes-*/*/*.bbappend"

BBFILE_COLLECTIONS += "meta-mld-source-layer"
BBFILE_PATTERN_meta-mld-source-layer := "^${LAYERDIR}/"
BBFILE_PRIORITY_meta-mld-source-layer = "7"


OEA-META-AIRDIGITAL-BASE := '${@os.path.normpath("${LAYERDIR}/")}'
```

## meta-hardware/conf/layer.conf
```bitbake
# We have a conf and classes directory, append to BBPATH
BBPATH .= ":${LAYERDIR}"

# We have a recipes directory, add to BBFILES
BBFILES += "${LAYERDIR}/recipes-*/*.bb ${LAYERDIR}/recipes-*/*.bbappend \
            ${LAYERDIR}/recipes-*/*/*.bb ${LAYERDIR}/recipes-*/*/*.bbappend"

BBFILE_COLLECTIONS += "meta-system-layer"
BBFILE_PATTERN_meta-hardware-layer := "^${LAYERDIR}/"
BBFILE_PRIORITY_meta-hardware-layer = "7"

OEA-META-AIRDIGITAL-BASE := '${@os.path.normpath("${LAYERDIR}/")}'
```

## meta-hardware/meta-i386/conf/layer.conf
```bitbake
# We have a conf and classes directory, append to BBPATH
BBPATH .= ":${LAYERDIR}"

# We have a recipes directory, add to BBFILES
BBFILES += "${LAYERDIR}/recipes-*/*.bb ${LAYERDIR}/recipes-*/*.bbappend \
            ${LAYERDIR}/recipes-*/*/*.bb ${LAYERDIR}/recipes-*/*/*.bbappend"

BBFILE_COLLECTIONS += "i386-layer"
BBFILE_PATTERN_i386-layer := "^${LAYERDIR}/"
BBFILE_PRIORITY_i386-layer = "7"

OEA-META-AIRDIGITAL-BASE := '${@os.path.normpath("${LAYERDIR}/")}'
```

## meta-hardware/meta-rpi/conf/layer.conf
```bitbake
# We have a conf and classes directory, append to BBPATH
BBPATH .= ":${LAYERDIR}"

# We have a recipes directory, add to BBFILES
BBFILES += "${LAYERDIR}/recipes-*/*.bb ${LAYERDIR}/recipes-*/*.bbappend \
            ${LAYERDIR}/recipes-*/*/*.bb ${LAYERDIR}/recipes-*/*/*.bbappend"

BBFILE_COLLECTIONS += "raspberrypi-layer"
BBFILE_PATTERN_raspberrypi-layer := "^${LAYERDIR}/"
BBFILE_PRIORITY_raspberrypi-layer = "7"

OEA-META-AIRDIGITAL-BASE := '${@os.path.normpath("${LAYERDIR}/")}'
```

## meta-hardware/meta-rpi2/conf/layer.conf
```bitbake
# We have a conf and classes directory, append to BBPATH
BBPATH .= ":${LAYERDIR}"

# We have a recipes directory, add to BBFILES
BBFILES += "${LAYERDIR}/recipes-*/*.bb ${LAYERDIR}/recipes-*/*.bbappend \
            ${LAYERDIR}/recipes-*/*/*.bb ${LAYERDIR}/recipes-*/*/*.bbappend"

BBFILE_COLLECTIONS += "rpi2-layer"
BBFILE_PATTERN_rpi2-layer := "^${LAYERDIR}/"
BBFILE_PRIORITY_rpi2-layer = "7"

OEA-META-AIRDIGITAL-BASE := '${@os.path.normpath("${LAYERDIR}/")}'
```

## meta-hardware/meta-rpiOFF/conf/machine/include/rpi-default-versions.inc
```bitbake
# RaspberryPi BSP default versions

#PREFERRED_VERSION_linux-raspberrypi ?= "4.13.%"
PREFERRED_VERSION_linux-raspberrypi ?= "4.14.%"
```

## meta-hardware/meta-rpiOFF/recipes-kernel/linux/linux-raspberrypi/defconfig
```kconfig
# Dummy file to get through do_kernel_configme.
CONFIG_KERNEL_LZMA=y
CONFIG_UDF_FS=y
CONFIG_FUSE_FS=y
CONFIG_HFSPLUS_FS=m
CONFIG_BLK_DEV_SR=y
CONFIG_BLK_DEV_INITRD y
CONFIG_INITRAMFS_SOURCE
CONFIG_RD_GZIP

CONFIG_INPUT_EVDEV=y
CONFIG_INPUT_KEYBOARD=y
CONFIG_INPUT_MOUSE=y
CONFIG_MOUSE_PS2=y
CONFIG_KEYBOARD_ATKBD=y

CONFIG_CPU_FREQ_DEFAULT_GOV_ONDEMAND=y
CONFIG_SPI_BCM2708=y

CONFIG_BTRFS_FS=y

CONFIG_I2C_BCM2835=y
CONFIG_CMDLINE="console=ttyAMA0,115200 kgdboc=ttyAMA0,115200 root=/dev/mmcblk0p2 rootfstype=ext4 rootwait"
```

## meta-hardware/meta-sunxi/conf/machine/draco.conf
```bitbake
#@TYPE: Machine
#@NAME: Draco
#@DESCRIPTION: Machine configuration for the Draco, based on allwinner A80 CPU 

require conf/machine/include/sun7i.inc

KERNEL_DEVICETREE = "sun9i-a80-cubieboard4.dtb"
UBOOT_MACHINE = "Merrii_A80_Optimus_defconfig"
SUNXI_FEX_FILE = "sys_config/a20/cubietruck.fex"
```

## meta-hardware/meta-x86/conf/layer.conf
```bitbake
# We have a conf and classes directory, append to BBPATH
BBPATH .= ":${LAYERDIR}"

# We have a recipes directory, add to BBFILES
BBFILES += "${LAYERDIR}/recipes-*/*.bb ${LAYERDIR}/recipes-*/*.bbappend \
            ${LAYERDIR}/recipes-*/*/*.bb ${LAYERDIR}/recipes-*/*/*.bbappend"

BBFILE_COLLECTIONS += "genericx86"
BBFILE_PATTERN_genericx86 := "^${LAYERDIR}/"
BBFILE_PRIORITY_genericx86 = "7"

OEA-META-AIRDIGITAL-BASE := '${@os.path.normpath("${LAYERDIR}/")}'
```
